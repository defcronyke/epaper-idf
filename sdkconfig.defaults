## sdkconfig.defaults
```kconfig
# epaper-idf
#
# Copyright (c) 2021 Jeremy Carter <jeremy@jeremycarter.ca>
#
# This code is released under the license terms contained in the
# file named LICENSE, which is found in the top-level folder in
# this project. You must agree to follow those license terms,
# otherwise you aren't allowed to copy, distribute, or use any 
# part of this project in any way.

CONFIG_APP_PROJECT_VER_FROM_CONFIG=n
#CONFIG_APP_PROJECT_VER="0"
# Default sdkconfig parameters to use the OTA
# partition table layout, with a 4MB flash size
CONFIG_ESPTOOLPY_FLASHSIZE_4MB=y
CONFIG_PARTITION_TABLE_TWO_OTA=y
CONFIG_PROJECT_FIRMWARE_UPGRADE_URL="https://esprog:8089/firmware.bin"
CONFIG_LWIP_LOCAL_HOSTNAME="epaper"
CONFIG_EXAMPLE_CONNECT_IPV6=n
CONFIG_EPAPER_IDF_MAIN_TASK_HTTP_SLIDESHOW_OPT=y
CONFIG_EXAMPLE_CONNECT_WIFI=y
CONFIG_HTTPD_MAX_REQ_HDR_LEN=2048
CONFIG_HTTPD_MAX_URI_LEN=2048
```
